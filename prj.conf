## prj.conf
```kconfig
CONFIG_STDOUT_CONSOLE=y
CONFIG_PRINTK=y
CONFIG_PWM=y
CONFIG_LOG=y
CONFIG_LOG_PRINTK=y
CONFIG_LOG_MODE_IMMEDIATE=y
CONFIG_PWM_LOG_LEVEL_DBG=y

# CONFIG_PWM_MEC1501=y
```

## mec15xxevb_assy6853_mec1501_hsz.overlay
```dts
// To get started, press Ctrl+Space to bring up the completion menu and view the available nodes.

// You can also use the buttons in the sidebar to perform actions on nodes.
// Actions currently available include:

// * Enabling / disabling the node
// * Adding the bus to a bus
// * Removing the node
// * Connecting ADC channels

// For more help, browse the DeviceTree documentation at https://docs.zephyrproject.org/latest/guides/dts/index.html
// You can also visit the nRF DeviceTree extension documentation at https://docs.nordicsemi.com/bundle/nrf-connect-vscode/page/guides/ncs_configure_app.html#devicetree-support-in-the-extension



// &pwm0 {
//     status = "okay";
// };

// &pwmleds {
//     compatible = "pwm-leds";

//     pwm_led0: pwm_led_0 {
//         pwms = <&pwm0 0 20000000 PWM_POLARITY_NORMAL>;  /* Channel 0, Period 20ms, Normal Polarity */
//         label = "PWM_LED0";
//     };
// };

// &pwm_led0{
//     pwms = <&pwm0 0 20000000 PWM_POLARITY_NORMAL>;  /* Channel 0, Period 20ms, Normal Polarity */
// };




// / {
//     aliases {
//         sw0 = &button0;  /* Alias for the button */
//     };
       
//     buttons {
//         compatible = "gpio-keys";
//         button0: button_0 {
//             gpios = <&gpio_140_176 0x12 (GPIO_ACTIVE_LOW | GPIO_PULL_UP)>;
//             label = "User Button";
//         };
//     };


//     pwmleds {
//         compatible = "pwm-leds";
    
//         pwm_led0: pwm_led_0 {
//             pwms = <&pwm0 0 20000000 0>; /* Channel 0, Period 20ms, Normal Polarity */
//             label = "PWM_LED0";
//         };
//     };

// };


/ {
    aliases {
        pwm-led0 = &pwm_led0;  /* Fix the alias name */
    };

    pwmleds {
        compatible = "pwm-leds";

        pwm_led0: pwm_led_0 {
            pwms = <&pwm0 0 500000000 0>; /* Channel 0,5000ms period, default polarity */
            label = "PWM_LED0";
        };
    };
};
```

## boards/mec15xxevb_assy6853_mec1501_hsz.overlay
```dts
// To get started, press Ctrl+Space to bring up the completion menu and view the available nodes.

// You can also use the buttons in the sidebar to perform actions on nodes.
// Actions currently available include:

// * Enabling / disabling the node
// * Adding the bus to a bus
// * Removing the node
// * Connecting ADC channels

// For more help, browse the DeviceTree documentation at https://docs.zephyrproject.org/latest/guides/dts/index.html
// You can also visit the nRF DeviceTree extension documentation at https://docs.nordicsemi.com/bundle/nrf-connect-vscode/page/guides/ncs_configure_app.html#devicetree-support-in-the-extension


// &pwm0 {
//     status = "okay";
//     channel-gpios = <&gpio_040_076 0xb GPIO_ACTIVE_HIGH>;
// };

// pwmleds {
//     compatible = "pwm-leds";
//     pwm_led0: pwm_led_0 {
//         pwms = <&pwm0 0 PWM_MSEC(20) PWM_POLARITY_NORMAL>; /* Channel 0, Period 20ms */
//         label = "PWM_LED0";
//     };
// };


&gpio_040_076 {
    status = "okay";
};

&pwm0 {
    compatible = "pwm";
    status = "okay";
    clock-frequency = <1000000>;  // Define the clock frequency for PWM
};



&pwm0 {
    status = "okay";
    channel-gpios = <&gpio_040_076 0xb GPIO_ACTIVE_HIGH>;
};

pwmleds {
    compatible = "pwm-leds";
    pwm_led0: pwm_led_0 {
        pwms = <&pwm0 0 PWM_MSEC(20) PWM_POLARITY_NORMAL>; /* Channel 0, Period 20ms */
        label = "PWM_LED0";
    };
};
```

## src/main.c
```c
/*
 * Copyright (c) 2016 Intel Corporation
 * Copyright (c) 2020 Nordic Semiconductor ASA
 *
 * SPDX-License-Identifier: Apache-2.0
 */

/**
 * @file Sample app to demonstrate PWM.
 */



#include <zephyr/kernel.h>
#include <zephyr/sys/printk.h>
#include <zephyr/device.h>
#include <zephyr/drivers/pwm.h>

static const struct pwm_dt_spec pwm_led0 = PWM_DT_SPEC_GET(DT_ALIAS(pwm_led0));

#define MIN_PERIOD PWM_MSEC(1)
#define MAX_PERIOD PWM_SEC(1U)

void main(void) {
    printk("PWM LED Control Example\n");

    if (!pwm_is_ready_dt(&pwm_led0)) {
        printk("Error: PWM device is not ready\n");
        return;
    }
    
    uint32_t period = MAX_PERIOD;
    uint8_t dir = 0; /* Direction of change: 0 = decrease, 1 = increase */

    while (1) {
        pwm_set_dt(&pwm_led0, period, period / 2);
        printk("PWM Period: %u\n", period);

        if (dir) {
            period *= 2;
            if (period > MAX_PERIOD) {
                period = MAX_PERIOD / 2;
                dir = 0;
            }
        } else {
            period /= 2;
            if (period < MIN_PERIOD) {
                period = MIN_PERIOD * 2;
                dir = 1;
            }
        }

        k_sleep(K_MSEC(500)); /* Adjust delay as needed */
    }
}
```
